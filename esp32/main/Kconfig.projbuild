## esp32/main/Kconfig.projbuild
```kconfig
menu "Hachidori bee3b Configuration"

config SSID
    string "WIFI access point name (SSID)"
    default "hachidori_ap"
    help
        Enter the name of the WIFI access point

config SSID_PASSWORD
    string "WIFI password"
    default "e15f44ecdff3a"
    help
        Enter ssid password

config UDP_SERVER_ADDRESS
    string "IPv4 address of UDP server"
    default "192.168.11.1"
    help
        IP address of the UDP server, normaly same with AP_ADDRESS

config UDP_PORT
    int "UDP port"
    default 5790
    help
        UDP port used for both Wi-Fi and ether

config PACKET_BUNDLE
    bool "Enable packet bundle"
    default "n"
    help
        If enabled, sensor packets can be bundled into one udp packet.

config MOTOR_ORDER_CW
    bool "Enable clockwise motor order"
    default "n"
    help
	If enabled, clockwise motor order is used. Otherwise APM
	motor order is used.

config LOW_BATTERY_CHECK
    bool "Low battery check"
    default "y"
    help
	If enabled, run into the deep sleep when low battery detected.

endmenu
```
